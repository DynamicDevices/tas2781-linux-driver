## Kconfig
```kconfig
menuconfig SND_SOC_TASDEVICE
	bool "Texas Instruments TASDEVICE"

if SND_SOC_TASEVICE
menu "Texas Instruments TASDEVICE"
config TASDEVICE_CODEC
	select REGMAP
	select REGMAP_I2C
	select I2C
	select SYSFS
	def_bool y

endmenu
endif #SND_SOC_TASDEVICE
```

## src/Kconfig
```kconfig
config SND_SOC_INTEGRATED_TASDEVICE
	tristate "Texas Instruments INTEGRATED TASDEVICE"
	select REGMAP
	select REGMAP_I2C
	select I2C
	select SYSFS
	select CRC8
	help
	  Enable support Texas Instruments integrated tasdevice.
	  To compile this driver as a module, choose M here.
	  If unsure select "N".
```
